## dts/bindings/pixart,pmw3610.yml
```yaml
description: |
  Sensor driver for the pixart PMW3610 mouse sensor 

compatible: "pixart,pmw3610"

include: spi-device.yaml

properties:
  irq-gpios:
    type: phandle-array
    required: true
  scroll-layers:
    type: array
    default: []
  snipe-layers:
    type: array
    default: []
  automouse-layer:
    type: int
    default: -1
  arrow-layers:
    type: array
    required: false
    default: []
    description: |
      Array of four layer indexes: [LEFT, RIGHT, UP, DOWN].
      Used in ARROW mode to emulate directional key presses.
```
